## samples/hrtimer/defconfig
```kconfig
CONFIG_LIBXENEMGCONS=y
CONFIG_LIBUKCONSOLE=y
CONFIG_LIBUKPRINT_KLVL_INFO=y

CONFIG_LIBPOSIX_TIME=y

CONFIG_LIBUKHRTIMER=y
```

## samples/shmemread/defconfig
```kconfig
CONFIG_LIBUKCONSOLE=y
CONFIG_XEN_STATIC_SHM=y

CONFIG_LIBUKPRINT_KLVL_INFO=y
CONFIG_LIBPOSIX_TIME=y
```
